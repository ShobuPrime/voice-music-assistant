## buildroot/package/thirdreality/nqptp/Config.in
```kconfig
config BR2_PACKAGE_NQPTP
	bool "nqptp"
	depends on BR2_USE_MMU # fork()
	depends on BR2_TOOLCHAIN_HAS_THREADS
	help
	  Not Quite PTP - a daemon that provides Precision Time Protocol
	  (PTP) timing services required by shairport-sync 4+ for AirPlay 2
	  group synchronization with HomePod and other AP2 receivers.

	  Listens on UDP ports 319 and 320 and writes a shared memory
	  region consumed by shairport-sync to synchronize playback clocks
	  across grouped AirPlay 2 endpoints.

	  https://github.com/mikebrady/nqptp
```

## buildroot/package/thirdreality/shairport-sync/Config.in
```kconfig
config BR2_PACKAGE_SHAIRPORT_SYNC
	bool "shairport-sync (AirPlay 2)"
	depends on BR2_USE_MMU # avahi, pulseaudio
	depends on !BR2_STATIC_LIBS # avahi
	depends on BR2_TOOLCHAIN_HAS_THREADS
	select BR2_PACKAGE_PULSEAUDIO
	select BR2_PACKAGE_AVAHI
	select BR2_PACKAGE_AVAHI_DAEMON
	select BR2_PACKAGE_OPENSSL
	select BR2_PACKAGE_LIBSOXR
	select BR2_PACKAGE_LIBPLIST
	select BR2_PACKAGE_LIBSODIUM
	select BR2_PACKAGE_POPT
	select BR2_PACKAGE_LIBGCRYPT
	select BR2_PACKAGE_NQPTP
	help
	  shairport-sync is an AirPlay audio receiver. With --with-airplay-2
	  enabled it implements AirPlay 2, allowing the speaker to be added to
	  HomePod / iOS Control Center groups with sample-accurate sync via
	  the companion nqptp PTP daemon.

	  This package builds shairport-sync 5.0.4 with the PulseAudio backend
	  (matching the speaker's existing audio sink), Avahi mDNS publishing,
	  OpenSSL, and libsoxr resampling. The runtime config is installed to
	  /etc/shairport-sync.conf.

	  https://github.com/mikebrady/shairport-sync

comment "shairport-sync needs a toolchain w/ threads, dynamic library"
	depends on BR2_USE_MMU
	depends on !BR2_TOOLCHAIN_HAS_THREADS || BR2_STATIC_LIBS
```
